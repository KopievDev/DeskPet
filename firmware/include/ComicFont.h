#pragma once

#include <stdint.h>
#include <LovyanGFX.hpp>

// Tiny 8x12 uppercase Cyrillic/ASCII bitmap subset for the comic bubble.
// Bitmaps were rasterized from DejaVu Sans Mono Bold (Bitstream Vera license)
// and deliberately include only glyphs used by the bundled short quips.
// This avoids depending on whatever Cyrillic fonts happen to be enabled
// in the firmware's LovyanGFX build.
namespace deskpet_comic {

struct Glyph {
    uint16_t codepoint;
    uint8_t rows[12]; // MSB is the leftmost pixel
};

static const Glyph kGlyphs[] = {
    {0x0021, {0x00, 0x00, 0x18, 0x18, 0x18, 0x18, 0x18, 0x00, 0x18, 0x18, 0x00, 0x00}}, // !
    {0x0023, {0x00, 0x00, 0x14, 0x34, 0x7E, 0x28, 0x28, 0xFC, 0x58, 0x50, 0x00, 0x00}}, // #
    {0x0024, {0x00, 0x10, 0x38, 0x50, 0x78, 0x3C, 0x14, 0x54, 0x38, 0x10, 0x10, 0x00}}, // $
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    {0x042D, {0x00, 0x78, 0x18, 0x0C, 0x7C, 0x7C, 0x0C, 0x58, 0x78, 0x00, 0x00, 0x00}}, // Э
};

inline uint16_t nextCodepoint(const char*& input) {
    const uint8_t a = static_cast<uint8_t>(*input++);
    if (a < 0x80u) return a;
    if ((a & 0xE0u) == 0xC0u && *input != '\0') {
        const uint8_t b = static_cast<uint8_t>(*input++);
        if ((b & 0xC0u) != 0x80u) return '?';
        return static_cast<uint16_t>(((a & 0x1Fu) << 6) | (b & 0x3Fu));
    }
    return '?'; // phrase catalogue is uppercase Russian + ASCII punctuation
}

inline uint16_t width(const char* text) {
    uint16_t count = 0;
    while (*text != '\0') {
        nextCodepoint(text);
        ++count;
    }
    return count * 8;
}

inline void draw(lgfx::LGFX_Sprite& canvas, int left, int top,
                 const char* text, uint16_t color) {
    while (*text != '\0') {
        const uint16_t codepoint = nextCodepoint(text);
        if (codepoint == ' ') {
            left += 8;
            continue;
        }
        const Glyph* found = nullptr;
        for (const auto& glyph : kGlyphs) {
            if (glyph.codepoint == codepoint) {
                found = &glyph;
                break;
            }
        }
        if (found) {
            for (uint8_t y = 0; y < 12; ++y) {
                const uint8_t bits = found->rows[y];
                for (uint8_t x = 0; x < 8; ++x) {
                    if ((bits & (0x80u >> x)) != 0u) {
                        canvas.drawPixel(left + x, top + y, color);
                    }
                }
            }
        }
        left += 8;
    }
}
} // namespace deskpet_comic
